## config/boards/yangxing/planck/Kconfig.defconfig
```kconfig
# SPDX-License-Identifier: MIT

if BOARD_PLANCK_LEFT

config ZMK_KEYBOARD_NAME
    default "Planck Split"

config ZMK_SPLIT_ROLE_CENTRAL
    default y

# 蓝牙连接数 = 外围设备(1) + 配置文件(5)
config BT_MAX_CONN
    default 6

config BT_MAX_PAIRED
    default 6

endif # BOARD_PLANCK_LEFT

if BOARD_PLANCK_LEFT || BOARD_PLANCK_RIGHT

config ZMK_SPLIT
    default y

config BT_CTLR
    default BT

if USB
config USB_NRFX
    default y

config USB_DEVICE_STACK
    default y
endif # USB

endif # BOARD_PLANCK_LEFT || BOARD_PLANCK_RIGHT
```
