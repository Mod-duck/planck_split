## Kconfig
```kconfig
# SPDX-License-Identifier: MIT

config PLANCK_BATTERY_LEDS
    bool "Planck battery level LEDs"
    default y
    depends on ZMK_BATTERY_REPORTING
    depends on LED
    help
      Display this half's local battery state of charge using its three
      PWM LEDs as a continuous three-segment battery bar.
```

## boards/yangxing/planck/planck_right_nrf52840_zmk_defconfig
```kconfig
# SPDX-License-Identifier: MIT

# 硬件驱动
CONFIG_ARM_MPU=y
CONFIG_HW_STACK_PROTECTION=y
CONFIG_GPIO=y
CONFIG_PINCTRL=y

# 时钟：内部 RC 振荡器 + 校准
CONFIG_CLOCK_CONTROL_NRF_K32SRC_RC=y
CONFIG_CLOCK_CONTROL_NRF_K32SRC_RC_CALIBRATION=y

# 构建输出
CONFIG_BUILD_OUTPUT_UF2=y
CONFIG_USE_DT_CODE_PARTITION=y

# PWM LED
CONFIG_PWM=y
CONFIG_LED=y
CONFIG_LED_PWM=y
```

## config/boards/modifier_key/planck/planck_left_nrf52840_zmk_defconfig
```kconfig
# SPDX-License-Identifier: MIT

# 时钟：内部 RC 振荡器 + 校准
CONFIG_CLOCK_CONTROL_NRF_K32SRC_RC=y
CONFIG_CLOCK_CONTROL_NRF_K32SRC_RC_CALIBRATION=y

# 核心功能
CONFIG_ZMK_USB=y
CONFIG_ZMK_BLE=y

# 构建输出
CONFIG_BUILD_OUTPUT_UF2=y
CONFIG_USE_DT_CODE_PARTITION=y

# PWM LED
CONFIG_PWM=y
CONFIG_LED=y
CONFIG_LED_PWM=y

# ZMK Studio
CONFIG_ZMK_STUDIO=y
CONFIG_ZMK_STUDIO_LOCKING=n

# 仅 central 有效的配置
CONFIG_ZMK_POINTING_SMOOTH_SCROLLING=y
CONFIG_ZMK_SPLIT_BLE_CENTRAL_BATTERY_LEVEL_FETCHING=y
CONFIG_ZMK_SPLIT_BLE_CENTRAL_BATTERY_LEVEL_PROXY=y

# 日志（排查蓝牙问题，仅左半central有USB）
CONFIG_ZMK_USB_LOGGING=y
CONFIG_LOG_PROCESS_THREAD_STARTUP_DELAY_MS=8000
```

## config/boards/yangxing/planck/board.yml
```yaml
boards:
  - name: planck_left
    vendor: yangxing
    socs:
      - name: nrf52840
        variants:
          - name: zmk
  - name: planck_right
    vendor: yangxing
    socs:
      - name: nrf52840
        variants:
          - name: zmk
```
